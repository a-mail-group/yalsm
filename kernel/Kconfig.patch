## kernel/Kconfig.patch
```kconfig
*** __orig/Kconfig	2017-11-12 19:46:13.000000000 +0100
--- Kconfig	2017-11-17 07:15:42.355368646 +0100
***************
*** 211,216 ****
--- 211,217 ----
  source security/apparmor/Kconfig
  source security/loadpin/Kconfig
  source security/yama/Kconfig
+ source security/mod_fgac/Kconfig
  
  source security/integrity/Kconfig
  
***************
*** 238,243 ****
--- 239,247 ----
  	config DEFAULT_SECURITY_APPARMOR
  		bool "AppArmor" if SECURITY_APPARMOR=y
  
+ 	config DEFAULT_SECURITY_MODFGAC
+ 		bool "mod_FGAC" if SECURITY_MODFGAC=y
+ 
  	config DEFAULT_SECURITY_DAC
  		bool "Unix Discretionary Access Controls"
  
***************
*** 249,254 ****
--- 253,259 ----
  	default "smack" if DEFAULT_SECURITY_SMACK
  	default "tomoyo" if DEFAULT_SECURITY_TOMOYO
  	default "apparmor" if DEFAULT_SECURITY_APPARMOR
+ 	default "mod_fgac" if DEFAULT_SECURITY_MODFGAC
  	default "" if DEFAULT_SECURITY_DAC
  
  endmenu
```

## kernel/mod_fgac/Kconfig
```kconfig
config SECURITY_MODFGAC
	bool "mod_FGAC Security Module"
	depends on SECURITY
	default n
	help
	  This selects the mod_FGAC Security Module.
	  mod_FGAC adds fine grained access control to the Kernel.

config SECURITY_MODFGAC_NETFILTER
	bool "mod_FGAC's Netfilter extension."
	depends on SECURITY
	depends on SECURITY_MODFGAC
	depends on NETFILTER
	default y
	help
	  This enables mod_FGAC to register Netfilter hooks, if any.
```
